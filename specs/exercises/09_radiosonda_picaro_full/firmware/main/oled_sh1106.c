/**
 * ============================================================================
 *  oled_sh1106.c  -  Driver minimo SH1106 (I2C) con fuente 5x7
 * ============================================================================
 *  El SH1106 tiene RAM de 132 columnas; las visibles empiezan en la col 2
 *  (por eso el offset de 2). Se direcciona por "paginas" de 8 pixeles de alto.
 * ============================================================================
 */
#include "oled_sh1106.h"
#include "i2c0.h"
#include "board_pins.h"
#include "esp_log.h"
#include "freertos/FreeRTOS.h"
#include "freertos/task.h"
#include <string.h>

static const char *TAG = "oled";
#define COL_OFFSET 2

static i2c_master_dev_handle_t s_dev;
static bool s_present;

/* Fuente 5x7 para ASCII 0x20..0x7E (cada glifo, 5 columnas). */
static const uint8_t FONT5x7[][5] = {
    {0x00,0x00,0x00,0x00,0x00},{0x00,0x00,0x5F,0x00,0x00},{0x00,0x07,0x00,0x07,0x00},
    {0x14,0x7F,0x14,0x7F,0x14},{0x24,0x2A,0x7F,0x2A,0x12},{0x23,0x13,0x08,0x64,0x62},
    {0x36,0x49,0x55,0x22,0x50},{0x00,0x05,0x03,0x00,0x00},{0x00,0x1C,0x22,0x41,0x00},
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    {0x44,0x64,0x54,0x4C,0x44},
};

static void cmd(uint8_t c) { uint8_t b[2] = {0x00, c}; i2c_master_transmit(s_dev, b, 2, pdMS_TO_TICKS(50)); }

static void set_pos(uint8_t page, uint8_t col)
{
    col += COL_OFFSET;
    cmd(0xB0 | (page & 0x0F));
    cmd(0x00 | (col & 0x0F));
    cmd(0x10 | (col >> 4));
}

esp_err_t oled_init(void)
{
    /* Elegir la direccion del OLED. OJO: en el T-Beam Supreme el magnetometro
     * QMC6310 tambien puede responder en 0x3C, y el OLED en 0x3D. Como el 0x3D
     * SOLO lo usa el OLED (el QMC nunca), lo probamos PRIMERO para no confundir
     * el display con el magnetometro. */
    uint8_t addr;
    if (i2c_master_probe(i2c0_bus(), 0x3D, 50) == ESP_OK) {
        addr = 0x3D;
    } else if (i2c_master_probe(i2c0_bus(), 0x3C, 50) == ESP_OK) {
        addr = 0x3C;
    } else {
        ESP_LOGW(TAG, "No hay OLED en 0x3D/0x3C (¿modulo no conectado?).");
        return ESP_FAIL;
    }
    ESP_LOGI(TAG, "OLED en 0x%02X", addr);
    i2c_device_config_t dc = {
        .dev_addr_length = I2C_ADDR_BIT_LEN_7,
        .device_address = addr,
        .scl_speed_hz = 400000,
    };
    if (i2c_master_bus_add_device(i2c0_bus(), &dc, &s_dev) != ESP_OK) return ESP_FAIL;

    static const uint8_t init_seq[] = {
        0xAE,             /* display off */
        0xD5, 0x80,       /* clock */
        0xA8, 0x3F,       /* multiplex 1/64 */
        0xD3, 0x00,       /* display offset 0 */
        0x40,             /* start line 0 */
        0xAD, 0x8B,       /* SH1106: DC-DC ON */
        0x8D, 0x14,       /* SSD1306: charge pump ON (por si el panel es SSD1306) */
        0xA1,             /* segment remap */
        0xC8,             /* COM scan dir */
        0xDA, 0x12,       /* COM pins */
        0x81, 0xCF,       /* contraste */
        0xD9, 0x22,       /* precharge */
        0xDB, 0x40,       /* vcom */
        0xA6,             /* normal (no invertido) */
        0xA4,             /* mostrar contenido de RAM */
        0xAF,             /* display ON */
    };
    for (size_t i = 0; i < sizeof(init_seq); i++) cmd(init_seq[i]);
    s_present = true;
    oled_clear();
    ESP_LOGI(TAG, "SH1106 iniciado");
    return ESP_OK;
}

bool oled_present(void) { return s_present; }

void oled_clear(void)
{
    if (!s_present) return;
    uint8_t zeros[132 + 1];
    zeros[0] = 0x40;
    memset(zeros + 1, 0, 132);
    for (uint8_t p = 0; p < 8; p++) {
        set_pos(p, 0);
        i2c_master_transmit(s_dev, zeros, sizeof(zeros), pdMS_TO_TICKS(50));
    }
}

void oled_line(uint8_t line, const char *text)
{
    if (!s_present || line > 7) return;
    uint8_t buf[1 + 128];
    buf[0] = 0x40;
    int x = 0;
    for (const char *p = text; *p && x <= 123; p++) {
        char c = *p;
        if (c < 0x20 || c > 0x7E) c = 0x20;
        const uint8_t *g = FONT5x7[c - 0x20];
        for (int i = 0; i < 5 && x < 128; i++) buf[1 + x++] = g[i];
        if (x < 128) buf[1 + x++] = 0x00;   /* espacio entre glifos */
    }
    while (x < 128) buf[1 + x++] = 0x00;     /* limpia el resto de la linea */
    set_pos(line, 0);
    i2c_master_transmit(s_dev, buf, 1 + 128, pdMS_TO_TICKS(50));
}
